## boards/arm/eknrf/Kconfig
```kconfig
# Copyright (c) 2022 The ZMK Contributors
# SPDX-License-Identifier: MIT

# For 0.3, we need to enable DCDC mode for the nrf52840 to get the best battery life. For 0.4, this is not required and may cause issues on some boards, so we only enable it for 0.4.
config BOARD_ENABLE_DCDC
    bool "Enable DCDC mode"
    select SOC_DCDC_NRF52X
    default y
    depends on (BOARD_ERNRF)
```

## boards/arm/eknrf/Kconfig.eknrf
```kconfig
# Puchi-BLE board configuration

# Copyright (c) 2022 The ZMK Contributors
# SPDX-License-Identifier: MIT

config BOARD_EKNRF
    select SOC_NRF52840_QIAA if BOARD_EKNRF_NRF52840_ZMK
    select ZMK_BOARD_COMPAT if BOARD_EKNRF_NRF52840_ZMK
    select SOC_NRF52840_QIAA
    imply RETAINED_MEM
    imply RETENTION
    imply RETENTION_BOOT_MODE
```

## boards/shields/ekgo/Kconfig.defconfig
```kconfig
if SHIELD_EKGO_LEFT

config ZMK_KEYBOARD_NAME
    default "Ekgo Trackpad"

config ZMK_SPLIT_ROLE_CENTRAL
    default y

config ZMK_SPLIT_BLE_CENTRAL_BATTERY_LEVEL_FETCHING
    default y

config ZMK_SPLIT_BLE_CENTRAL_BATTERY_LEVEL_PROXY
    default y
    
endif

if SHIELD_EKGO_LEFT || SHIELD_EKGO_RIGHT

config ZMK_SPLIT
    default y

config ZMK_POINTING
    default y

config SPI
    default y

endif
```

## boards/shields/ekgo/Kconfig.shield
```kconfig
# Copyright (c) 2020 The ZMK Contributors
# SPDX-License-Identifier: MIT

config SHIELD_EKGO_LEFT
    def_bool $(shields_list_contains,ekgo_left)

config SHIELD_EKGO_RIGHT
    def_bool $(shields_list_contains,ekgo_right)
```

## boards/shields/ekgo_tb/Kconfig.shield
```kconfig
# Copyright (c) 2020 The ZMK Contributors
# SPDX-License-Identifier: MIT

config SHIELD_EKGO_TB_LEFT
    def_bool $(shields_list_contains,ekgo_tb_left)

config SHIELD_EKGO_TB_RIGHT
    def_bool $(shields_list_contains,ekgo_tb_right)
```

## boards/shields/ekgo_trackball/Kconfig.defconfig
```kconfig
if SHIELD_EKGO_TRACKBALL_LEFT

config ZMK_KEYBOARD_NAME
    default "Ekgo Trackball"

config ZMK_SPLIT_ROLE_CENTRAL
    default y

config ZMK_SPLIT_BLE_CENTRAL_BATTERY_LEVEL_FETCHING
    default y

config ZMK_SPLIT_BLE_CENTRAL_BATTERY_LEVEL_PROXY
    default y
    
endif

if SHIELD_EKGO_TRACKBALL_LEFT || SHIELD_EKGO_TRACKBALL_RIGHT

config ZMK_SPLIT
    default y

config ZMK_POINTING
    default y

config SPI
    default y

endif
```

## boards/shields/ekgo_trackball/Kconfig.shield
```kconfig
# Copyright (c) 2020 The ZMK Contributors
# SPDX-License-Identifier: MIT

config SHIELD_EKGO_TRACKBALL_LEFT
    def_bool $(shields_list_contains,ekgo_trackball_left)

config SHIELD_EKGO_TRACKBALL_RIGHT
    def_bool $(shields_list_contains,ekgo_trackball_right)
```

## config/west.yml
```yaml
manifest:
  remotes:
    - name: zmkfirmware
      url-base: https://github.com/zmkfirmware
    # - name: petejohanson
    #   url-base: https://github.com/petejohanson/
    # - name: badjeff
    #   url-base: https://github.com/badjeff
    # - name: efogdev
    #   url-base: https://github.com/efogdev
    # - name: caksoylar
    #   url-base: https://github.com/caksoylar
  projects:
    - name: zmk
      remote: zmkfirmware
      revision: main
      import: app/west.yml
    # - name: cirque-input-module
    #   remote: petejohanson
    #   revision: main
    # - name: zmk-rgbled-widget
    #   remote: caksoylar
    #   revision: main
    # - name: zmk-pmw3610-driver
    #   remote: badjeff
    #   revision: main
    # - name: zmk-report-rate-limit
    #   remote: efogdev
    #   revision: main
    # # - name: zmk-input-processor-xyz
    # #   remote: badjeff
    # #   revision: main
    # - name: zmk-rgbled-widget
    #   remote: caksoylar
    #   revision: main
  self:
    path: config
```
